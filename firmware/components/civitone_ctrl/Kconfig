## firmware/components/civitone_ctrl/Kconfig
```kconfig
menu "Civitone control channel"
    config CIVITONE_BOARD
        string "Board name sent in hello"
        default "amped-esp32-plus"
    config CIVITONE_ROLE_SOURCE
        bool "This board is a source (sends audio), not a speaker"
        default n
        help
            The hello says role "source" with 48 kHz mono, the device id
            starts with "src-", and civitone_ctrl_send_audio streams PCM.
endmenu
```

## firmware/components/civitone_setup/Kconfig
```kconfig
menu "Civitone setup"
    config CIVITONE_DEFAULT_SERVER
        string "Server address pre-filled on the setup page"
        default "civitone.rettysoftware.com"
        help
            Official builds point at the hosted server; self-hosters change it
            on the setup page or here.
    config CIVITONE_SETUP_AFTER_S
        int "Seconds without Wi-Fi before the setup network comes back"
        default 60
endmenu
```
